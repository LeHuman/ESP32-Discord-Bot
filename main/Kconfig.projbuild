## main/Kconfig.projbuild
```kconfig
menu "ESP config"

    menu "Discord Bot"

        config BOT_TOKEN
            string "Discord Bot API Token"
            default "APITOKENTHINGY"
            help
                Set your discord bot API token

                Ensure that you do not accidently upload it to a public repository

        config BOT_PREFIX
            string "Discord Bot Prefix"
            default "!Cast"
            help
                Set the required prefix of a message

                The bot will ignore any other messages

        config BOT_CASE_SENSITIVE
            bool "Bot is case sensitive"
            default n
            help
                Set whether the bot is case sensitve

    endmenu

    menu "HTTP"

        config HTTP_HOST
            string "HTTP Hostname"
            default "discordapp.com"
            help
                The host name that the HTTP Client should use for sending messages

        config HTTP_MAX_BUFFER
            int "Max HTTP Buffer size"
            default 2048
            help
                Set the maximum size that the HTTP Client is able to receive

    endmenu

    menu "REST POST"

        config REST_PATH_PATTERN
            string "POST path pattern"
            default "/api/channels/%s/messages"
            help
                Set the pattern for the path of POST requests

                %s is replaced with a channel_id

        config REST_AUTH_PREFIX
            string "Authentication Prefix"
            default "Bot "
            help
                Set the prefix for the authentication header

                The Discord Bot API Token is concatenated after this string

    endmenu

    menu "Websocket"

        config WEBSOCKET_BUFFER_SIZE
            int "Websocket buffer size"
            default 8192
            help
                Set the maximum size of a websocket message before it is split

                Currently the bot does not support split messages, which is why it is this big

        config WEBSOCKET_QUEUE_SIZE
            int "Websocket queue size"
            default 3
            help
                Set the maximum number of websocket messages to store

        config WEBSOCKET_URI
            string "Websocket endpoint URI"
            default "wss://gateway.discord.gg/?v=6&encoding=json"
            help
                Set the URL of the websocket endpoint

        config WEBSOCKET_TIMEOUT_SEC
            int "Websocket no data timeout"
            default 10
            help
                Set the time it takes for the websocket to timeout when it is not receiving data

                This probably will only be used when the bot is having trouble connecting to the websocket

    endmenu

    menu "Wifi"

        config ESP_WIFI_SSID
            string "WiFi SSID"
            default "Riveria-Network"
            help
                Set the SSID (network name) for the station to connect to

        config ESP_WIFI_PASSWORD
            string "WiFi Password"
            default "FZvfm^##A!*g4fWB"
            help
                Set the WiFi password (WPA or WPA2) for the station to use

        config ESP_MAXIMUM_RETRY
            int "Maximum retry"
            default 5
            help
                Set the maximum number of retries to avoid reconnecting to the AP when it really is inexistent.

    endmenu

    menu "LED"
        config BLINK_ENABLE
            bool "Enable LED Blinking"
            default y
            help
                Set whether to enable led blinking on activity

        config BLINK_GPIO
            int "Blink GPIO number"
            depends on BLINK_ENABLE
            range 0 34
            default 2
            help
                Set the GPIO number (IOxx) to blink on and off.

                Some GPIOs are used for other purposes (flash connections, etc.) and cannot be used to blink.

                GPIOs 35-39 are input-only so they cannot be used as outputs.

    endmenu

endmenu
```
